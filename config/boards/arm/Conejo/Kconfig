## config/boards/arm/Conejo/Kconfig
```kconfig
# Copyright (c) 2022 Kurtis Lew
# SPDX-License-Identifier: MIT

config BOARD_ENABLE_DCDC
	bool "Enable DCDC mode"
	select SOC_DCDC_NRF52X
	default y
	depends on BOARD_CONEJO_LEFT || BOARD_CONEJO_RIGHT
```

## config/boards/arm/Conejo/Kconfig.board
```kconfig
# Copyright (c) 2022 Kurtis Lew
# SPDX-License-Identifier: MIT

config BOARD_CONEJO_LEFT
	bool "conejo_left"
	depends on SOC_NRF52840_QIAA

config BOARD_CONEJO_RIGHT
	bool "conejo_right"
	depends on SOC_NRF52840_QIAA
```

## config/boards/arm/Conejo/Kconfig.defconfig
```kconfig
# Copyright (c) 2022 Kurtis Lew
# SPDX-License-Identifier: MIT

if BOARD_CONEJO_LEFT

config ZMK_KEYBOARD_NAME
	default "Conejo"

config ZMK_SPLIT_ROLE_CENTRAL
    default y

endif # BOARD_CONEJO_LEFT

if BOARD_CONEJO_LEFT || BOARD_CONEJO_RIGHT

config BOARD 
    default "conejo"

config ZMK_SPLIT
    default y

config I2C
    bool
	default y

config SPI
    bool
	default y

config BT_CTLR
	default BT

config ZMK_BLE
	default y

config ZMK_USB
	default y

if USB

config USB_NRFX
	default y

config USB_DEVICE_STACK
	default y

endif # USB

config ZMK_EXT_POWER
	default y

config MAX17048
	default y

endif # BOARD_CONEJO_LEFT || BOARD_CONEJO_RIGHT
```

## config/boards/arm/Conejo/conejo_left_defconfig
```kconfig
# Copyright (c) 2022 Kurtis Lew
# SPDX-License-Identifier: MIT

CONFIG_SOC_SERIES_NRF52X=y
CONFIG_SOC_NRF52840_QIAA=y
CONFIG_BOARD_CONEJO_LEFT=y
CONFIG_ZMK_HID_REPORT_TYPE_NKRO=y

CONFIG_ZMK_USB=y

CONFIG_ZMK_BLE=y
CONFIG_BT_MAX_PAIRED=3
CONFIG_BT_MAX_CONN=3
CONFIG_ZMK_BLE_EXPERIMENTAL_CONN=y

CONFIG_ZMK_SLEEP=y

# Enable MPU
CONFIG_ARM_MPU=y

# enable GPIO
CONFIG_GPIO=y

# Enable I2C
CONFIG_I2C=y
#CONFIG_I2C_NRFX=y
#CONFIG_I2C_0=y

# Enable SPI
CONFIG_SPI=y
#CONFIG_SPI_NRFX=y

CONFIG_USE_DT_CODE_PARTITION=y
CONFIG_BUILD_OUTPUT_UF2=y

CONFIG_MPU_ALLOW_FLASH_WRITE=y
CONFIG_NVS=y
CONFIG_SETTINGS_NVS=y
CONFIG_FLASH=y
CONFIG_FLASH_PAGE_LAYOUT=y
CONFIG_FLASH_MAP=y

CONFIG_ZMK_RGB_UNDERGLOW=y
CONFIG_WS2812_STRIP=y

# Turn on logging, and set ZMK logging to debug output
CONFIG_LOG=y
CONFIG_ZMK_USB_LOGGING=y
#CONFIG_ZMK_LOG_LEVEL_DBG=y
#CONFIG_LOG_BUFFER_SIZE=65536
#CONFIG_LOG_STRDUP_BUF_COUNT=160
#CONFIG_I2C_LOG_LEVEL_DBG=y
#CONFIG_SPI_LOG_LEVEL_DBG=y
#CONFIG_SENSOR_LOG_LEVEL_DBG=y
#CONFIG_LOG_PROCESS_THREAD_STARTUP_DELAY_MS=8000

# Turn on USB CDC ACM device
#CONFIG_USB=y
#CONFIG_USB_DEVICE_STACK=y
#CONFIG_USB_CDC_ACM=y
#CONFIG_USB_CDC_ACM_RINGBUF_SIZE=1024
#CONFIG_USB_CDC_ACM_DEVICE_NAME="CDC_ACM"
#CONFIG_USB_CDC_ACM_DEVICE_COUNT=1

# Enable serial console
#CONFIG_SERIAL=y
#CONFIG_CONSOLE=y
#CONFIG_UART_INTERRUPT_DRIVEN=y
#CONFIG_UART_LINE_CTRL=y

# Enable USB UART, and set the console device
#CONFIG_UART_CONSOLE=y
#CONFIG_USB_UART_CONSOLE=y
#CONFIG_UART_CONSOLE_ON_DEV_NAME="CDC_ACM_0"
```

## config/boards/shields/encoder/Kconfig.defconfig
```kconfig
# Copyright (c) 2022 The ZMK Contributors
# SPDX-License-Identifier: MIT

if SHIELD_ENCODER

config ZMK_KEYBOARD_NAME
    default "Encoder Tester"

endif
```

## config/boards/shields/two_percent_toggle/Kconfig.defconfig
```kconfig
# Copyright (c) 2022 The ZMK Contributors
# SPDX-License-Identifier: MIT

if SHIELD_TWO_PERCENT_TOGGLE

config ZMK_KEYBOARD_NAME
    default "2% Toggle"

endif
```

## config/boards/shields/two_percent_toggle/Kconfig.shield
```kconfig
# Copyright (c) 2022 The ZMK Contributors
# SPDX-License-Identifier: MIT

config SHIELD_TWO_PERCENT_TOGGLE
	def_bool $(shields_list_contains,two_percent_toggle)
```

## config/west.yml
```yaml
manifest:
  remotes:
    - name: zmkfirmware
      url-base: https://github.com/zmkfirmware
    - name: zmkfirmware-kurtis
      url-base: https://github.com/kurtis-lew
  projects:
    - name: zmk
      remote: zmkfirmware-kurtis
      revision: toggleswitch_2.0_PR
      import: app/west.yml
  self:
    path: config
```
